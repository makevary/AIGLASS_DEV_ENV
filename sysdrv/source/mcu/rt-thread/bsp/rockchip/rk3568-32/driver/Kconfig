## sysdrv/source/mcu/rt-thread/bsp/rockchip/rk3568-32/driver/Kconfig
```kconfig
source "$BSP_DIR/../common/drivers/Kconfig"

menu "RT-Thread rockchip RK3568 drivers"

config RT_USING_CACHE_ECC
    bool "Enable Cache ECC"
    default n

menu "Enable CAN"
    config RT_USING_CAN
        bool "Enable CAN"
        default n

    if RT_USING_CAN
    config RT_USING_CAN1
        bool "Enable CAN1"
        default n
    endif
endmenu

config RT_USING_CRU
    bool "Enable CRU"
    default n

menu "Enable GMAC"
    config RT_USING_GMAC
        bool "Enable GMAC"
        select RT_USING_LWIP
        default n

    if RT_USING_GMAC
    config RT_USING_GMAC0
        bool "Enable GMAC0"
        default n
    config RT_USING_GMAC1
        bool "Enable GMAC1"
        default n
    endif
endmenu

config RT_USING_DMA
    bool "Enable General DMA Framework"
    default n

if RT_USING_DMA
config RT_USING_DMA_PL330
    bool "Enable PL330 DMA Controller"
    default n
endif

config RT_USING_I2C0
    bool "Enable I2C0"
    select RT_USING_I2C
    default n

config RT_USING_SYSTICK
    bool "Enable SYSTICK"
    default y

menu "Enable UART"
    config RT_USING_UART
        bool "Enable UART"
        default y

    if RT_USING_UART
    config RT_USING_UART2
        bool "Enable UART2"
        default y

    config RT_USING_UART4
        bool "Enable UART4"
        default n
    endif
endmenu

if RT_USING_SDIO
menu "Enable SDIO/SDMMC/eMMC"
    config RT_USING_SDIO0
        bool "Enable SDIO controller"
        default n
endmenu
endif

config RT_USING_DW_PCIE
    bool "Enable DW PCIE"
    default n

config RT_USING_PCIE_DMA
    bool "Enable PCIE DMA"
    default n

config RT_USING_WITH_LINUX
    bool "Enable USING WITH LINUX"
    default n

if RT_USING_PWM
menu "Enable PWM"
    config RT_USING_PWM0
        bool "Enable PWM0"
        default n

    config RT_USING_PWM1
        bool "Enable PWM1"
        default n

    config RT_USING_PWM2
        bool "Enable PWM2"
        default n

    config RT_USING_PWM3
        bool "Enable PWM3"
        default n
endmenu
endif

endmenu
```

## sysdrv/source/mcu/rt-thread/bsp/rockchip/rv1103b-mcu/board/Kconfig
```kconfig
menu "RT-Thread board config"

config RT_BOARD_NAME
    string "the board name of you use"
    default "rv1103b-fpga"

config RT_USING_CAM_STREAM_ON_LATE
    bool "cam stream on delay after ae init"
    default y

source "$BSP_DIR/board/$RT_BOARD_NAME/Kconfig"

endmenu
```
